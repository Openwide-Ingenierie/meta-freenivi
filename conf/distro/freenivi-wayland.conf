## conf/distro/freenivi-wayland.conf
```bitbake
include freenivi.inc

DISTRO_NAME = "Freenivi Wayland"

DISTRO = "freenivi-wayland"

DISTRO_FEATURES += "wayland"
```

## conf/distro/freenivi-x11.conf
```bitbake
include freenivi.inc

DISTRO_NAME = "Freenivi X11"

DISTRO = "freenivi-x11"

DISTRO_FEATURES += "x11"

XSERVER ?= " \
	xserver-xorg \
	xauth \
	xf86-input-evdev \
	xf86-input-mouse \
	xf86-input-keyboard \
	mesa-driver-swrast \
	${@base_contains("MACHINE_ARCH", "qemux86", "xf86-video-vmware", "", d)} \
	${@base_contains("MACHINE_ARCH", "qemux86_64", "xf86-video-vmware", "", d)} \
	${@base_contains("MACHINE_ARCH", "vexpressa9", "xf86-video-fbdev", "", d)} \
"
XSERVER += " \
	xserver-xf86-config \
	xserver-xorg-extension-dbe \
	xserver-xorg-extension-dri \
	xserver-xorg-extension-dri2 \
	xserver-xorg-extension-extmod \
	xserver-xorg-extension-glx \
	xauth \
"
```

## conf/layer.conf
```bitbake
# We have a conf and classes directory, add to BBPATH
BBPATH .= ":${LAYERDIR}"

# We have a packages directory, add to BBFILES
BBFILES += "${LAYERDIR}/recipes-*/*/*.bb \
            ${LAYERDIR}/recipes-*/*/*.bbappend"

BBFILE_COLLECTIONS += "meta-freenivi"
BBFILE_PATTERN_meta-freenivi := "^${LAYERDIR}/"
BBFILE_PRIORITY_meta-freenivi = "20"

# Let us add layer-specific bbappends which are only applied when that
# layer is included in our configuration
BBFILES += "${@' '.join('${LAYERDIR}/%s/recipes*/*/*.bbappend' % layer \
               for layer in BBFILE_COLLECTIONS.split())}"

# See https://github.com/openembedded/oe-core/commit/dee005b6e1bc353230f9f27a469b2054a644e542 for more details on this workaround
SOC_FAMILY ??= ""
```
